## Kconfig
```kconfig
menu "QP Embedded Framework"
  config QP_ENABLED
    bool "QP Real-Time Embedded Framework"
    help
      Select this option to enable QPC Framework

  menu "QPC Configuration"
    visible if QP_ENABLED
    choice QPC_PINNED_TO_CORE_CHOICE
      prompt "The cpu core which QPC run"
      depends on !FREERTOS_UNICORE
      help
        Specify the cpu core to run QPC.
      config QPC_PINNED_TO_CORE_0
        bool "Core 0 (PRO CPU)"
      config QPC_PINNED_TO_CORE_1
        bool "Core 1 (APP CPU)"
      config QPC_NO_CORE_AFFINITY
        bool "No Affinity (PRO or APP CPU)"
    endchoice #QPC_PINNED_TO_CORE_CHOICE

    menu "Event Memory Pool"
      visible if QP_ENABLED
      config QPC_SMALL_POOL_SIZE
        int "Small Memory Pool Size"
        depends on QP_ENABLED
        range 16 512
        default 32
        help
          Max number of events in a small memory pool
      config QPC_MEDIUM_POOL_SIZE
        int "Medium Memory Pool Size"
        depends on QP_ENABLED
        range 16 512
        default 32
        help
          Max number of events in a medium memory pool
      config QPC_LARGE_POOL_SIZE
        int "Large Memory Pool Size"
        depends on QP_ENABLED
        range 16 512
        default 32
        help
          Max number of events in a large memory pool
    endmenu #"Event Memory Pool"

    choice QPC_QSPY_PHY_INTERFACE
      prompt "QSPY Interface"
      default QPC_QSPY_PHY_UART

      config QPC_QSPY_PHY_UART
        bool "Via UART Interface"

      config QPC_QSPY_PHY_BT_SPP
        bool "Via Bluetooth"

      config QPC_QSPY_PHY_WIFI
        bool "Via Wifi"
  endchoice

  choice QPC_QSPY_UART_PORT
    depends on QPC_QSPY_PHY_UART
    prompt "UART"
    default QPC_QSPY_UART1
    help 
      Select the uart port number used by the QSPY

    config QPC_QSPY_UART1
      bool "UART 1"
    
    config QPC_QSPY_UART2
      bool "UART 2"
    
  endchoice

  menu "UART pin map"
    depends on QPC_QSPY_PHY_UART
    config QPC_QSPY_TX_PIN
      int "QPC QSPY TX"
      range 0 39
      default 0
    config QPC_QSPY_RX_PIN
      int "QPC QSPY RX"
      range 0 39 
      default 27
  endmenu #"UART pin map"

  menu "QSPY Stack Size"
      visible if QP_ENABLED
      config QPC_QSPY_STACK_SIZE
        int "QSPY Task Stack Size"
        depends on QP_ENABLED
        range 1024 2048
        default 2048
        help
          QSPY Stask Stack Size

      config QPC_QSPY_TX_SIZE
        int "QSPY TX Buffer Size"
        depends on QP_ENABLED
        range 16 512
        default 512
        help
          QSPY TX Buffer Size
      config QPC_QSPY_RX_SIZE
        int "QSPY RX Buffer Size"
        depends on QP_ENABLED
        range 16 512
        default 256
        help
          QSPY RX Buffer Size
  endmenu #"QSPY Stack Size"
endmenu #QPC Configuration

endmenu
```
